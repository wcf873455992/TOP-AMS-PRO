## sdkconfig.defaults
```kconfig
CONFIG_ESP_WIFI_SOFTAP_SUPPORT=y
CONFIG_ESP_WIFI_STA_AUTO_DHCP_RETRY=y
CONFIG_ESP_HTTP_SERVER_ENABLE=y
CONFIG_LOG_DEFAULT_LEVEL_INFO=y
CONFIG_LWIP_DHCPS_LEASE_UNIT=60

CONFIG_ESPTOOLPY_FLASHSIZE_4MB=y
CONFIG_PARTITION_TABLE_CUSTOM=y
CONFIG_PARTITION_TABLE_CUSTOM_FILENAME="partitions.csv"

CONFIG_ESP_SYSTEM_RTC_EXT_MEM=y

CONFIG_ESP_TLS_INSECURE=y
CONFIG_ESP_TLS_SKIP_SERVER_CERT_VERIFY=y

CONFIG_LWIP_MAX_SOCKETS=16
CONFIG_APP_PROJECT_VER="TOP_AMS_Pro"
```
